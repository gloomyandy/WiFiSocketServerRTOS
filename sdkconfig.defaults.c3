## sdkconfig.defaults.c3
```kconfig
CONFIG_ESP32C3_DEFAULT_CPU_FREQ_160=y
CONFIG_ESP32C3_DEFAULT_CPU_FREQ_MHZ=160

# Task watchdog: armed at runtime with main task as the only subscriber.
# Idle-task subscription is disabled so a healthy idle task cannot mask a wedged main.
CONFIG_ESP_TASK_WDT=y
CONFIG_ESP_TASK_WDT_PANIC=y
CONFIG_ESP_TASK_WDT_CHECK_IDLE_TASK_CPU0=n
```

## sdkconfig.defaults.esp32c3
```kconfig
# ESP32 config
CONFIG_ESP32_WIFI_STATIC_RX_BUFFER_NUM=20
CONFIG_ESP32_WIFI_DYNAMIC_RX_BUFFER_NUM=40
CONFIG_ESP32_WIFI_DYNAMIC_TX_BUFFER_NUM=40
CONFIG_ESP32_WIFI_AMPDU_TX_ENABLED=y
CONFIG_ESP32_WIFI_TX_BA_WIN=32
CONFIG_ESP32_WIFI_AMPDU_RX_ENABLED=y
CONFIG_ESP32_WIFI_RX_BA_WIN=32
CONFIG_ESP32_WIFI_NVS_ENABLED=n

CONFIG_ESP32C3_DEFAULT_CPU_FREQ_160=y
CONFIG_ESP32C3_DEFAULT_CPU_FREQ_MHZ=160

# Component config
CONFIG_ESPTOOLPY_MONITOR_BAUD_OTHER_VAL=74880
CONFIG_ESPTOOLPY_MONITOR_BAUD=74880
CONFIG_ESPTOOLPY_MONITOR_BAUD_OTHER=y
CONFIG_ESPTOOLPY_FLASHMODE_QIO=y
CONFIG_ESPTOOLPY_FLASHFREQ_80M=y
CONFIG_ESPTOOLPY_FLASHSIZE_4MB=y

CONFIG_PARTITION_TABLE_CUSTOM_FILENAME="partitions.esp32c3.csv"

CONFIG_COMPILER_OPTIMIZATION_PERF=y

CONFIG_LWIP_TCP_SND_BUF_DEFAULT=40960
CONFIG_LWIP_TCP_WND_DEFAULT=40960
CONFIG_LWIP_TCP_RECVMBOX_SIZE=64
CONFIG_LWIP_UDP_RECVMBOX_SIZE=64
CONFIG_LWIP_TCPIP_RECVMBOX_SIZE=64
CONFIG_LWIP_IRAM_OPTIMIZATION=y

CONFIG_ESP_NETIF_TCPIP_ADAPTER_COMPATIBLE_LAYER=y

CONFIG_ESP_CONSOLE_UART_BAUDRATE=74880
CONFIG_ESP_CONSOLE_UART_CUSTOM=y
CONFIG_ESP_CONSOLE_SECONDARY_NONE=y

CONFIG_SPI_MASTER_IN_IRAM=y

CONFIG_MDNS_TASK_STACK_SIZE=2076

# CONFIG_ESP_TIMER_TASK_STACK_SIZE=440
CONFIG_ESP_TIMER_TASK_STACK_SIZE=2048

# CONFIG_FREERTOS_TIMER_TASK_STACK_DEPTH=476
CONFIG_FREERTOS_TIMER_TASK_STACK_DEPTH=1536

# CONFIG_FREERTOS_IDLE_TASK_STACKSIZE=288
CONFIG_FREERTOS_IDLE_TASK_STACKSIZE=768
```

## sdkconfig.defaults.esp8266
```kconfig
CONFIG_ESP_PHY_INIT_DATA_VDD33_CONST=255
CONFIG_SOC_FULL_ICACHE=y
CONFIG_ESP8266_WIFI_RX_BUFFER_NUM=26
CONFIG_ESP8266_WIFI_LEFT_CONTINUOUS_RX_BUFFER_NUM=4
CONFIG_ESP8266_DEFAULT_CPU_FREQ_160=y

CONFIG_LWIP_TCP_SND_BUF_DEFAULT=7300
CONFIG_LWIP_TCP_WND_DEFAULT=7300
CONFIG_LWIP_TCP_MSS=1460
CONFIG_LWIP_TCP_RECVMBOX_SIZE=7

CONFIG_PARTITION_TABLE_CUSTOM_FILENAME="partitions.esp8266.csv"

CONFIG_LOG_SET_LEVEL=y
CONFIG_COMPILER_OPTIMIZATION_LEVEL_RELEASE=y
```

## sdkconfig.defaults.s3
```kconfig
CONFIG_ESP32S3_INSTRUCTION_CACHE_32KB=y
CONFIG_ESP32S3_INSTRUCTION_CACHE_LINE_32B=y
CONFIG_ESP32S3_INSTRUCTION_CACHE_WRAP=y
CONFIG_ESP32S3_DEFAULT_CPU_FREQ_240=y
CONFIG_ESP32S3_DEFAULT_CPU_FREQ_MHZ=240

# Task watchdog: armed at runtime with main task as the only subscriber.
# Idle-task subscription is disabled so a healthy idle task cannot mask a wedged main.
CONFIG_ESP_TASK_WDT=y
CONFIG_ESP_TASK_WDT_PANIC=y
CONFIG_ESP_TASK_WDT_CHECK_IDLE_TASK_CPU0=n
CONFIG_ESP_TASK_WDT_CHECK_IDLE_TASK_CPU1=n
```
