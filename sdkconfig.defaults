## sdkconfig.defaults.esp32
```kconfig
CONFIG_COMPILER_OPTIMIZATION_PERF=y

CONFIG_PARTITION_TABLE_CUSTOM_FILENAME="partitions.esp32.csv"

CONFIG_BOOTLOADER_LOG_LEVEL_ERROR=y

CONFIG_ESPTOOLPY_FLASHSIZE_4MB=y

CONFIG_ESP_DEFAULT_CPU_FREQ_MHZ_240=y
CONFIG_ESP_DEFAULT_CPU_FREQ_MHZ=240


CONFIG_ESP_WIFI_STATIC_RX_BUFFER_NUM=25
CONFIG_ESP_WIFI_DYNAMIC_RX_BUFFER_NUM=64
CONFIG_ESP_WIFI_DYNAMIC_TX_BUFFER_NUM=64
CONFIG_ESP_WIFI_AMPDU_TX_ENABLED=y
CONFIG_ESP_WIFI_TX_BA_WIN=32
CONFIG_ESP_WIFI_AMPDU_RX_ENABLED=y
CONFIG_ESP_WIFI_RX_BA_WIN=32
CONFIG_ESP_WIFI_NVS_ENABLED=n

#CONFIG_MBEDTLS_DYNAMIC_FREE_CONFIG_CA_CERT=y

#CONFIG_LWIP_TCP_WND_DEFAULT=17280
#CONFIG_LWIP_TCP_WND_DEFAULT=46080
CONFIG_LWIP_TCP_WND_DEFAULT=34560
CONFIG_LWIP_TCP_RECVMBOX_SIZE=64
CONFIG_LWIP_UDP_RECVMBOX_SIZE=64
CONFIG_LWIP_TCPIP_RECVMBOX_SIZE=64
CONFIG_LWIP_IRAM_OPTIMIZATION=y
CONFIG_LWIP_TCPIP_TASK_AFFINITY_CPU1=y

CONFIG_ESP_NETIF_HOSTNAME_MAX_LENGTH=64

CONFIG_ESP_SYSTEM_PANIC_PRINT_REBOOT=y

#CONFIG_ESP_NETIF_TCPIP_ADAPTER_COMPATIBLE_LAYER=y

CONFIG_ESP_CONSOLE_SECONDARY_NONE=y

CONFIG_FREERTOS_IN_IRAM=y
CONFIG_SPI_MASTER_IN_IRAM=y

CONFIG_ESP_MAIN_TASK_AFFINITY_CPU1=y

CONFIG_MDNS_TASK_AFFINITY_NO_AFFINITY=y

CONFIG_ETH_RMII_CLK_OUTPUT=y
CONFIG_ETH_RMII_CLK_OUT_GPIO=17
CONFIG_ETH_DMA_BUFFER_SIZE=1024
CONFIG_ETH_DMA_RX_BUFFER_NUM=20
CONFIG_ETH_DMA_TX_BUFFER_NUM=20
CONFIG_ETH_SOFT_FLOW_CONTROL=y
# Task watchdog: armed at runtime with main task as the only subscriber.
# Idle-task subscription is disabled so a healthy idle task cannot mask a wedged main.
CONFIG_ESP_TASK_WDT_EN=y
CONFIG_ESP_TASK_WDT_INIT=n
CONFIG_ESP_TASK_WDT_PANIC=n
CONFIG_ESP_TASK_WDT_CHECK_IDLE_TASK_CPU0=n
CONFIG_ESP_TASK_WDT_CHECK_IDLE_TASK_CPU1=n
```
